# file: target_022_FreeRTOS_helloworld.ioc
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Mcu.Family=STM32F4
Mcu.Name=STM32F411V(C-E)Tx
Mcu.Package=LQFP100
NVIC.PriorityGroup=NVIC_PRIORITYGROUP_4
NVIC.TIM5_IRQn=true\:15\:0\:false\:false\:true\:false\:true\:true
NVIC.TimeBase=TIM5_IRQn
NVIC.TimeBaseIP=TIM5
ProjectManager.HeapSize=0x200
ProjectManager.StackSize=0x400
ProjectManager.TargetToolchain=STM32CubeIDE
RCC.AHBFreq_Value=16000000
RCC.APB1Freq_Value=16000000
RCC.APB2Freq_Value=16000000
RCC.CortexFreq_Value=16000000
RCC.HSE_VALUE=25000000
RCC.HSI_VALUE=16000000
RCC.LSE_VALUE=32768
RCC.SYSCLKFreq_VALUE=16000000
RCC.VCOOutputFreq_Value=192000000
VP_SYS_VS_tim5.Mode=TIM5
board=custom

// file: Core/Src/main.c
/* USER CODE BEGIN Header */
/**
 ******************************************************************************
 * @file           : main.c
 * @brief          : Main program body
 ******************************************************************************
 * @attention
 *
 * Copyright (c) 2023 STMicroelectronics.
 * All rights reserved.
 *
 * This software is licensed under terms that can be found in the LICENSE file
 * in the root directory of this software component.
 * If no LICENSE file comes with this software, it is provided AS-IS.
 *
 ******************************************************************************
 */
/* USER CODE END Header */
#include "main.h"

/* USER CODE BEGIN Includes */
#include <stdio.h>
#include "FreeRTOS.h"
#include "task.h"
/* USER CODE END Includes */

/* USER CODE BEGIN PV */

#define DWT_CTRL		(*(volatile uint32_t*) 0xE0001000UL)

/* USER CODE END PV */

void SystemClock_Config(void);
/* USER CODE BEGIN PFP */
static void Task1_Function(void *parameters);
static void Task2_Function(void *parameters);
/* USER CODE END PFP */

int main(void) {
	/* USER CODE BEGIN 1 */

	TaskHandle_t Task1_Handler;
	TaskHandle_t Task2_Handler;

	BaseType_t status;

	/* USER CODE END 1 */

	/* MCU Configuration--------------------------------------------------------*/

	/* Reset of all peripherals, Initializes the Flash interface and the Systick. */
	HAL_Init();

	/* Configure the system clock */
	SystemClock_Config();

	/* Initialize all configured peripherals */
	/* USER CODE BEGIN 2 */

	// Enable the CYCCNT counter (before Task Creation)
	DWT_CTRL |= (1 << 0);

	SEGGER_SYSVIEW_Conf();

	SEGGER_SYSVIEW_Start();

	status = xTaskCreate(Task1_Function, "Task1", 200,
			"Hello world from task 1\n", 2, &Task1_Handler);

	configASSERT(status == pdPASS);

	status = xTaskCreate(Task2_Function, "Task2", 200,
			"Hello world from task 2\n", 2, &Task2_Handler);

	configASSERT(status == pdPASS);

	// Start the FreeRTOS Scheduler
	vTaskStartScheduler();

	/*
	 * If the control comes here, then the launch of the scheduler has failed
	 * due to insufficient memory in heap.
	 */

	/* USER CODE END 2 */

	/* Infinite loop */
	while (1) {

	}
}

void SystemClock_Config(void) {
	RCC_OscInitTypeDef RCC_OscInitStruct = { 0 };
	RCC_ClkInitTypeDef RCC_ClkInitStruct = { 0 };

	/** Configure the main internal regulator output voltage
	 */
	__HAL_RCC_PWR_CLK_ENABLE();
	__HAL_PWR_VOLTAGESCALING_CONFIG(PWR_REGULATOR_VOLTAGE_SCALE1);

	/** Initializes the RCC Oscillators according to the specified parameters
	 * in the RCC_OscInitTypeDef structure.
	 */
	RCC_OscInitStruct.OscillatorType = RCC_OSCILLATORTYPE_HSI;
	RCC_OscInitStruct.HSIState = RCC_HSI_ON;
	RCC_OscInitStruct.HSICalibrationValue = RCC_HSICALIBRATION_DEFAULT;
	RCC_OscInitStruct.PLL.PLLState = RCC_PLL_NONE;
	if (HAL_RCC_OscConfig(&RCC_OscInitStruct) != HAL_OK) {
		Error_Handler();
	}

	/** Initializes the CPU, AHB and APB buses clocks
	 */
	RCC_ClkInitStruct.ClockType = RCC_CLOCKTYPE_HCLK | RCC_CLOCKTYPE_SYSCLK
			| RCC_CLOCKTYPE_PCLK1 | RCC_CLOCKTYPE_PCLK2;
	RCC_ClkInitStruct.SYSCLKSource = RCC_SYSCLKSOURCE_HSI;
	RCC_ClkInitStruct.AHBCLKDivider = RCC_SYSCLK_DIV1;
	RCC_ClkInitStruct.APB1CLKDivider = RCC_HCLK_DIV1;
	RCC_ClkInitStruct.APB2CLKDivider = RCC_HCLK_DIV1;

	if (HAL_RCC_ClockConfig(&RCC_ClkInitStruct, FLASH_LATENCY_0) != HAL_OK) {
		Error_Handler();
	}
}

/* USER CODE BEGIN 4 */

// Scope of this function is limited in this main.c file
static void Task1_Function(void *parameters) {
	char msg[100];
	while (1) {
		printf("%s\n", (char*) parameters);

		snprintf(msg, 100, "%s\n", (char*) parameters);

		SEGGER_SYSVIEW_PrintfTarget(msg);

		taskYIELD();
	}
}

// Scope of this function is limited in this main.c file
static void Task2_Function(void *parameters) {
	char msg[100];
	while (1) {
		printf("%s\n", (char*) parameters);

		snprintf(msg, 100, "%s\n", (char*) parameters);

		SEGGER_SYSVIEW_PrintfTarget(msg);

		taskYIELD();
	}
}

/* USER CODE END 4 */

void HAL_TIM_PeriodElapsedCallback(TIM_HandleTypeDef *htim) {
	if (htim->Instance == TIM5) {
		HAL_IncTick();
	}
}

void Error_Handler(void) {
	__disable_irq();
	while (1) {
	}
}
